## src/platforms/esp32/components/avm_m5unified/Kconfig
```kconfig
menu "AtomVM M5Unified Component"

config AVM_ENABLE_M5UNIFIED_NIFS
    bool "Enable M5Unified NIFs"
    default y
    help
        Enable AtomVM NIFs for M5Unified (m5:begin/0, m5:display_print/1, etc.)

endmenu
```

## src/platforms/esp32/components/avm_zenoh/Kconfig
```kconfig
menu "AtomVM Zenoh Component"

config AVM_ENABLE_ZENOH_NIFS
    bool "Enable Zenoh-pico NIFs"
    default y
    help
        Enable Zenoh pub/sub NIFs for AtomVM.
        Requires zenoh-pico to be present in the components directory.
        WiFi must be connected before calling zenoh:open/1.

endmenu
```

## src/platforms/esp32/sdkconfig.defaults
```kconfig
CONFIG_PARTITION_TABLE_CUSTOM=y
CONFIG_ESPTOOLPY_FLASHSIZE_4MB=y
CONFIG_MBEDTLS_ECP_FIXED_POINT_OPTIM=y
CONFIG_LWIP_IPV6=n
CONFIG_PARTITION_TABLE_CUSTOM_FILENAME="partitions.csv"
CONFIG_APP_REPRODUCIBLE_BUILD=y

# Allow M5Unified (new I2C driver) and AtomVM (legacy I2C driver) to coexist.
CONFIG_I2C_SKIP_LEGACY_CONFLICT_CHECK=y
```
